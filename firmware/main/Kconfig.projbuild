## firmware/main/Kconfig.projbuild
```kconfig
menu "Codex ESP32 Display"

config CODEX_ATTENTION_WIFI_SSID
    string "Wi-Fi SSID"
    default "CHANGE_ME"

config CODEX_ATTENTION_WIFI_PASSWORD
    string "Wi-Fi password"
    default ""
    help
        Leave blank only for an open network. This value is stored in sdkconfig,
        which is ignored by Git in this repository.

config CODEX_ATTENTION_BRIDGE_URL
    string "Bridge attention endpoint"
    default "http://192.168.1.2:5180/api/v1/attention"
    help
        Full URL of the Mac bridge endpoint, reachable from this ESP32.

config CODEX_ATTENTION_BRIDGE_TOKEN
    string "Bridge bearer token"
    default ""
    help
        Copy the token generated by `npm run setup` in the bridge directory.

config CODEX_ATTENTION_POLL_INTERVAL_MS
    int "Poll interval (milliseconds)"
    range 500 60000
    default 2000

config CODEX_ATTENTION_MAX_ITEMS
    int "Maximum cards retained on device"
    range 1 40
    default 20

endmenu
```
